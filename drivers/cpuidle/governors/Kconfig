## drivers/cpuidle/governors/Kconfig
```kconfig
config CPU_IDLE_GOV_TEO
    bool "Timer events oriented (TEO) governor"
    default y
    help
      This governor uses a timer events oriented approach to select
      the idle state for the CPU.
```
